/*
<<<<<<<< HEAD:arch/arm/boot/dts/omap3-gta04a4.dts
 * Copyright (C) 2014 Marek Belisko <marek@goldelico.com>
========
 * include/linux/display_state.h
 *
 * Copyright (c) 2016-2017 Francisco Franco
 * franciscofranco.1990@gmail.com
>>>>>>>> p9x:include/linux/display_state.h
 *
 * This program is free software; you can redistribute it and/or modify
 * it under the terms of the GNU General Public License version 2 as
 * published by the Free Software Foundation.
 */

<<<<<<<< HEAD:arch/arm/boot/dts/omap3-gta04a4.dts
#include "omap3-gta04.dtsi"

/ {
	model = "Goldelico GTA04A4";
};
========
#ifndef _LINUX_DISPLAY_STATE_H
#define _LINUX_DISPLAY_STATE_H

bool is_display_on(void);

#endif
>>>>>>>> p9x:include/linux/display_state.h
