## drivers/input/touchscreen/misc/Kconfig
```kconfig
config INPUT_FPC1020
		tristate "Fpc1020 fingerprint sensor support"
		depends on SPI
		help
		  Say Y here if you have Fpc1020 sensor hooked to an SPI bus.

config HALL
		tristate "HALL Switch"
		help
		 If you say yes here, you get support for hall switch control device
	
```
